## config/boards/shields/elexx_split64_v1/Kconfig.defconfig
```kconfig
if SHIELD_ELEXX_SPLIT64_V1_LEFT

config ZMK_KEYBOARD_NAME
    default "Elexx Split64"

config ZMK_SPLIT_ROLE_CENTRAL
    default y

endif # SHIELD_ELEXX_SPLIT64_V1_LEFT

if SHIELD_ELEXX_SPLIT64_V1_LEFT || SHIELD_ELEXX_SPLIT64_V1_RIGHT

config ZMK_SPLIT
    default y

endif # SHIELD_ELEXX_SPLIT64_V1_LEFT || SHIELD_ELEXX_SPLIT64_V1_RIGHT
```

## config/boards/shields/elexx_split64_v1/Kconfig.shield
```kconfig
config SHIELD_ELEXX_SPLIT64_V1_LEFT
    def_bool $(shields_list_contains,elexx_split64_v1_left)

config SHIELD_ELEXX_SPLIT64_V1_RIGHT
    def_bool $(shields_list_contains,elexx_split64_v1_right)
```
